## CMakeLists.txt
```
# Copyright (c) 2026 Adi Nandanamudi
# SPDX-License-Identifier: Apache-2.0

cmake_minimum_required(VERSION 3.28.0)

list(APPEND ZEPHYR_EXTRA_MODULES ${CMAKE_CURRENT_SOURCE_DIR}/../../..)

find_package(Zephyr REQUIRED HINTS $ENV{ZEPHYR_BASE})
project(watch_remote)

target_sources(app PRIVATE src/main.c src/qspi_fast.c src/trace.c)
target_sources(app PRIVATE src/watch_img.c src/speed_img.c src/knob_img.c)


# Per-pixel maths: let sqrtf inline to the FPU sequence (no errno handling).
set_source_files_properties(src/main.c PROPERTIES COMPILE_OPTIONS "-fno-math-errno;-O2")
```

## Kconfig
```
# Copyright (c) 2026 Adi Nandanamudi
# SPDX-License-Identifier: Apache-2.0

menu "Watch (core 1)"

config WATCH_TRACE
	bool "Event trace (T1/T0 on the console, tools/trace)"
	default y

# Each optimisation can be switched back off, to measure it against the
# version before it (docs/optimization-log.md). Build with, for example,
#   west build ... -- -Dwatch_remote_CONFIG_WATCH_FAST_SPI=n
config WATCH_FAST_SPI
	bool "Direct SPI register path for display writes (else the Zephyr driver)"
	default y

config WATCH_SPI_OVERLAP
	bool "Compose the next box while the previous one is sent by DMA"
	default y
	depends on WATCH_FAST_SPI

config WATCH_RING_RAM
	bool "Keep the bezel ring strip in internal RAM (else read it from flash)"
	default y

config WATCH_SWEEP_GATE
	bool "Skip the second-hand stage in boxes it cannot reach"
	default y

config WATCH_TE_LOCK
	bool "Start frames on the panel's tearing-effect edge (else free-running)"
	default y

endmenu

source "Kconfig.zephyr"
```

## prj.conf
```kconfig
CONFIG_IPM=y
CONFIG_MAIN_STACK_SIZE=6144
CONFIG_HEAP_MEM_POOL_SIZE=512
CONFIG_DISPLAY=y
CONFIG_SPI=y
CONFIG_DMA=y
CONFIG_GPIO=y

# hardware FPU on core 1 (the compositor is float-heavy)
CONFIG_FPU=y
```

## src/knob_img.h
```c
/* Generated by tools/watchface/knob.py - do not edit. */

#ifndef KNOB_IMG_H_
#define KNOB_IMG_H_

#include <stdint.h>
#include <zephyr/toolchain.h>

#define KNOB_CLICK_DEG 3
#define KNOB_KEY_DEG 15
extern const uint8_t knob_pal_flash[]; /* 256 x RGB565 */
extern const uint8_t knob_q[];   /* u8 [ANG][RAD], same layout as watch_ring_q */
#define MUTED_W 120
#define MUTED_H 40
#define MUTED_X0 (-60)  /* from the middle */
#define MUTED_Y0 (-166)
extern const uint8_t muted_a[];  /* A8 'MUTED' label */

#endif
```

## src/qspi_fast.c
```c
/*
 * Copyright (c) 2026 Adi Nandanamudi
 * SPDX-License-Identifier: Apache-2.0
 *
 * Fast CO5300 window writes, driving the SPI2 registers directly.
 *
 * The Zephyr driver works, but costs ~100 us per window: three driver calls
 * (CASET, RASET, pixels), each reconfiguring the GDMA, with the 1-line header
 * bit-expanded into quad data. Here the SPI peripheral's own phases do the
 * protocol: an 8-bit command and a 24-bit address on one line, then the data
 * (1 line for parameters from the CPU buffer, 4 lines for pixels by DMA).
 * CASET and RASET take about a microsecond each, and a window's pixels go out
 * by DMA while the caller composes the next one.
 *
 * The Zephyr SPI and display drivers still do the setup (pins, clock, mode,
 * GDMA channel connected to SPI2): call this only after display_write() has
 * run at least once. From then on, this file owns SPI2.
 */

#include <zephyr/device.h>
#include <zephyr/drivers/dma.h>
#include <hal/spi_ll.h>
#include <soc/spi_struct.h>

#include "qspi_fast.h"
#include "trace.h"

#define CO_OP_CMD    0x02
#define CO_OP_PIXELS 0x32
#define CO_CASET     0x2A
#define CO_RASET     0x2B
#define CO_RAMWR     0x2C
#define CO_X_OFF     6    /* panel column offset (devicetree column-offset) */
#define DMA_TX_CH    1    /* GDMA pair 0, TX (core 1's devicetree dmas) */

static spi_dev_t *const hw = &GPSPI2;
static const struct device *const dma = DEVICE_DT_GET(DT_NODELABEL(dma));
static bool busy;
uint32_t qf_underruns;

void qf_wait(void)
{
	if (busy) {
		if (!spi_ll_usr_is_done(hw)) { /* the CPU stalls here until the DMA is done */
			uint32_t t0 = trace_now();

			while (!spi_ll_usr_is_done(hw)) {
			}
			trace_ev(TR_SPI_WAIT, 0, MIN(trace_now() - t0, 0xffff));
		}
		busy = false;
		if (hw->dma_int_raw.outfifo_empty_err) {
			qf_underruns++;
			spi_ll_outfifo_empty_clr(hw);
		}
	}
}

/* Command + address phases on one line: op, then {0x00, reg, 0x00}. */
static void header(uint8_t op, uint8_t reg, int data_lines)
{
	spi_ll_clear_int_stat(hw);
	spi_ll_master_set_line_mode(hw, (spi_line_mode_t){.cmd_lines = 1, .addr_lines = 1,
							   .data_lines = data_lines});
	spi_ll_set_dummy(hw, 0);
	spi_ll_set_command_bitlen(hw, 8);
	spi_ll_set_command(hw, op, 8, false);
	spi_ll_set_addr_bitlen(hw, 24);
	spi_ll_set_address(hw, (uint32_t)reg << 8, 24, false);
	spi_ll_enable_miso(hw, 0);
	spi_ll_master_keep_cs(hw, 0);
}

static void cmd4(uint8_t reg, uint16_t a, uint16_t b)
{
	const uint8_t p[4] = {a >> 8, a & 0xff, b >> 8, b & 0xff};

	qf_wait();
	header(CO_OP_CMD, reg, 1);
	spi_ll_dma_tx_enable(hw, 0);
	spi_ll_set_mosi_bitlen(hw, 32);
	spi_ll_write_buffer(hw, p, 32);
	spi_ll_enable_mosi(hw, 1);
	spi_ll_apply_config(hw);
	spi_ll_user_start(hw);
	busy = true;
}

void qf_write(int x, int y, int w, int h, const void *buf)
{
	size_t len = (size_t)w * h * 2;

	cmd4(CO_CASET, x + CO_X_OFF, x + CO_X_OFF + w - 1);
	cmd4(CO_RASET, y, y + h - 1);
	qf_wait();

	header(CO_OP_PIXELS, CO_RAMWR, 4);
	spi_ll_set_mosi_bitlen(hw, len * 8);
	spi_ll_dma_tx_fifo_reset(hw);
	spi_ll_outfifo_empty_clr(hw);
	dma_reload(dma, DMA_TX_CH, (uint32_t)buf, 0, len);
	dma_start(dma, DMA_TX_CH);
	spi_ll_dma_tx_enable(hw, 1);
	spi_ll_enable_mosi(hw, 1);
	spi_ll_apply_config(hw);
	spi_ll_user_start(hw);
	busy = true;
}
```

## src/qspi_fast.h
```c
/*
 * Copyright (c) 2026 Adi Nandanamudi
 * SPDX-License-Identifier: Apache-2.0
 */
#pragma once

#include <stdint.h>

/* Start sending a w x h RGB565 (big-endian) window to the CO5300 at (x, y).
 * Returns once the pixel DMA is running; buf must stay untouched until the
 * next qf_write() or qf_wait() returns.
 */
void qf_write(int x, int y, int w, int h, const void *buf);

/* Wait for the last transfer to finish. */
void qf_wait(void);

/* Transfers so far whose TX FIFO ran empty mid-transfer (corrupt pixels). */
extern uint32_t qf_underruns;
```

## src/speed_img.h
```c
/* Generated by tools/watchface/chrono.py - do not edit. */

#ifndef SPEED_IMG_H_
#define SPEED_IMG_H_

#include <stdint.h>
#include <zephyr/toolchain.h>

#define SPEED_SUB_OFF 104
#define SPEED_SUB_R 50

extern const uint8_t speed_dial[];       /* black, RGB565 LE, 466 x 466 */
extern const uint8_t speed_white_dial[]; /* white, RGB565 LE, 466 x 466 */

#endif
```

## src/trace.c
```c
/*
 * Copyright (c) 2026 Adi Nandanamudi
 * SPDX-License-Identifier: Apache-2.0
 */

#include <string.h>
#include <zephyr/device.h>
#include <zephyr/drivers/ipm.h>
#include "trace.h"
#include "../../common/watch_msg.h"

#ifdef CONFIG_WATCH_TRACE

/* Two batches: one filling while the other is sent. Events are added from
 * the main loop and from the IPM interrupt, so the index is guarded.
 */
static struct msg_trace batch[2];
static int cur, dropped;
volatile bool trace_on;

static const struct device *const ipm_dev = DEVICE_DT_GET(DT_NODELABEL(ipm0));

void trace_put(uint8_t ev, uint8_t a, uint16_t b)
{
	uint32_t key = irq_lock();
	struct msg_trace *m = &batch[cur];

	if (m->n < TRACE_BATCH) {
		m->ev[m->n++] = (struct trace_ev){.ts = trace_now(), .ev = ev, .a = a, .b = b};
	} else {
		dropped++; /* the main loop has not flushed yet */
	}
	irq_unlock(key);
}

void trace_flush_room(int room)
{
	if (batch[cur].n + room <= TRACE_BATCH && trace_on) {
		return; /* enough room left (when stopping, send what there is) */
	}
	uint32_t key = irq_lock();
	int send = cur;

	cur ^= 1;
	batch[cur].n = 0;
	irq_unlock(key);
	if (batch[send].n) {
		msg_send(ipm_dev, MSG_TRACE, &batch[send],
			 1 + batch[send].n * sizeof(struct trace_ev));
		batch[send].n = 0;
	}
}

void trace_set(bool on)
{
	uint32_t key = irq_lock();

	if (on && !trace_on) {
		batch[0].n = batch[1].n = 0;
		cur = 0;
		dropped = 0;
	}
	trace_on = on;
	irq_unlock(key);
}

#endif
```

## src/trace.h
```c
/*
 * Copyright (c) 2026 Adi Nandanamudi
 * SPDX-License-Identifier: Apache-2.0
 *
 * Core 1's side of the event trace: events go into a small staging buffer
 * (core 1 has little RAM) and are sent to core 0 in batches from the main
 * loop. Cheap when off: one load and a branch.
 */
#pragma once

#include <stdbool.h>
#include <stdint.h>
#include <zephyr/kernel.h>
#include "../../common/trace.h"

#ifdef CONFIG_WATCH_TRACE
extern volatile bool trace_on;
void trace_put(uint8_t ev, uint8_t a, uint16_t b);
void trace_set(bool on);  /* from MSG_TRACE_CTL */
void trace_flush_room(int room); /* send the batch if fewer than room events fit */
static inline void trace_flush(void) { trace_flush_room(1); }

static inline void trace_ev(uint8_t ev, uint8_t a, uint16_t b)
{
	if (trace_on) {
		trace_put(ev, a, b);
	}
}
#else
static inline void trace_ev(uint8_t ev, uint8_t a, uint16_t b) {}
static inline void trace_set(bool on) {}
static inline void trace_flush(void) {}
static inline void trace_flush_room(int room) {}
#endif
```

## src/watch_img.h
```c
/* Generated by tools/watchface/watch.py export - do not edit. */
#ifndef WATCH_IMG_H_
#define WATCH_IMG_H_

#include <stdint.h>

#define WATCH_SIZE 466
#define WATCH_BEZEL_IN 193
#define WATCH_BEZEL_OUT 233

extern const uint8_t watch_dial[];   /* RGB565 */

/* bezel ring lookup (see export()) */
#define WATCH_RING_ANG 1440
#define WATCH_RING_RAD 43
#define WATCH_RING_R0 191
extern const uint8_t watch_ring_pal[];     /* 256 x RGB565 */
extern const uint8_t watch_ring_q[];       /* u8 [ANG][RAD]: palette index */
extern const uint8_t watch_ring_idx[];     /* u16 per ring pixel: strip index */
extern const uint8_t watch_ring_row_off[]; /* u32 per row: first pixel */
extern const uint8_t watch_ring_spans[];   /* 2 x (i16 x0, i16 x1) per row */

extern const uint8_t watch_dates[]; /* 31 x RGB565, day 1 first */
#define WATCH_DATE_W 44
#define WATCH_DATE_H 30
#define WATCH_DATE_CX 385
#define WATCH_DATE_CY 233

#endif
```
