## boards/waveshare/esp32s3_touch_amoled_1_75/esp32s3_touch_amoled_1_75_esp32s3_appcpu_defconfig
```kconfig
# Copyright (c) 2026 Adi Nandanamudi
# SPDX-License-Identifier: Apache-2.0

CONFIG_CLOCK_CONTROL=y
```

## boards/waveshare/esp32s3_touch_amoled_1_75/esp32s3_touch_amoled_1_75_esp32s3_procpu_defconfig
```kconfig
# Copyright (c) 2026 Adi Nandanamudi
# SPDX-License-Identifier: Apache-2.0

CONFIG_CONSOLE=y
CONFIG_SERIAL=y
CONFIG_UART_CONSOLE=y
CONFIG_GPIO=y
CONFIG_CLOCK_CONTROL=y
```

## drivers/Kconfig
```kconfig
# Copyright (c) 2026 Adi Nandanamudi
# SPDX-License-Identifier: Apache-2.0

menu "Board drivers (amoled_175)"
rsource "audio/Kconfig"
rsource "input/Kconfig"
endmenu
```

## drivers/audio/Kconfig
```kconfig
# SPDX-License-Identifier: Apache-2.0

config AUDIO_CODEC_ES8311
	bool "ES8311 mono codec (DAC path)"
	default y
	depends on DT_HAS_EVEREST_ES8311_ENABLED
	depends on AUDIO_CODEC
	select I2C
	help
	  Everest ES8311, used here as the speaker DAC (I2S target, MCLK in).

config AUDIO_CODEC_ES7210
	bool "ES7210 4-channel ADC"
	default y
	depends on DT_HAS_EVEREST_ES7210_ENABLED
	depends on AUDIO_CODEC
	select I2C
	help
	  Everest ES7210 microphone ADC (I2S target, MCLK in). MIC1/MIC2 in
	  standard I2S stereo; TDM for MIC3/MIC4 is not supported yet.
```

## drivers/display/Kconfig
```kconfig
# Copyright (c) 2026 Adi Nandanamudi
# SPDX-License-Identifier: Apache-2.0

config CO5300_QSPI
	bool "Chipone CO5300 AMOLED over QSPI"
	default y
	depends on DT_HAS_CHIPONE_CO5300_QSPI_ENABLED
	select SPI
	select SPI_EXTENDED_MODES
	select GPIO
	help
	  SPI_EXTENDED_MODES is needed for SPI_LINES_QUAD: without it the SPI
	  operation word is 16 bits and the quad flag is silently dropped.
```

## drivers/input/Kconfig
```kconfig
# Copyright (c) 2026 Adi Nandanamudi
# SPDX-License-Identifier: Apache-2.0

config INPUT_CST9217
	bool "Hynitron CST9217 capacitive touch controller"
	default y
	depends on DT_HAS_HYNITRON_CST9217_ENABLED
	select I2C
	select GPIO
	select INPUT_TOUCH
	help
	  Hynitron CST9217 (and CST9220) touch controller over I2C, as used on
	  the Waveshare ESP32-S3-Touch-AMOLED-1.75.

config INPUT_CST9217_POLL_MS
	int "CST9217 poll period while touched (ms)"
	default 20
	depends on INPUT_CST9217
	help
	  The chip pulses its interrupt line on first contact and then only about
	  once a second while a finger stays down, so the driver polls at this
	  rate until the finger lifts.
```

## dts/bindings/audio/everest,es7210.yaml
```yaml
# SPDX-License-Identifier: Apache-2.0

description: |
  Everest ES7210 4-channel microphone ADC, as an I2S target clocked from MCLK.
  MIC1 and MIC2 come out as standard I2S left/right.

compatible: "everest,es7210"

include: i2c-device.yaml

properties:
  mic-gain-db:
    type: int
    default: 30
    description: Initial PGA gain for MIC1/MIC2 in dB (0..33, 3 dB steps).
```

## dts/bindings/audio/everest,es8311.yaml
```yaml
# SPDX-License-Identifier: Apache-2.0

description: |
  Everest ES8311 mono audio codec. This driver uses the DAC path only, as an
  I2S target clocked from MCLK.

compatible: "everest,es8311"

include: i2c-device.yaml

properties:
  pa-gpios:
    type: phandle-array
    description: |
      Speaker amplifier enable. Switched on by start_output (after the I2S
      stream is running, to avoid a pop) and off by stop_output.
```

## dts/bindings/display/chipone,co5300-qspi.yaml
```yaml
# Copyright (c) 2026 Adi Nandanamudi
# SPDX-License-Identifier: Apache-2.0

description: |
  Chipone CO5300 AMOLED controller on a 4-line (QSPI) bus. Commands go out
  as opcode 0x02 + {0x00, cmd, 0x00} on one line; pixels as opcode 0x32 +
  {0x00, 0x2C/0x3C, 0x00} followed by RGB565 on four lines.

  Upstream "chipone,co5300" (on spi) writes pixels on one line; this driver
  uses all four.

compatible: "chipone,co5300-qspi"

include: [spi-device.yaml, display-controller.yaml]

properties:
  reset-gpios:
    type: phandle-array
    required: true
  column-offset:
    type: int
    default: 0
    description: First visible column in controller RAM (6 on the 1.75" round panel).
  row-offset:
    type: int
    default: 0
```

## dts/bindings/input/hynitron,cst9217.yaml
```yaml
# Copyright (c) 2026 Adi Nandanamudi
# SPDX-License-Identifier: Apache-2.0

description: |
  Hynitron CST9217 capacitive touch controller (I2C, 0x5A). Reports
  INPUT_ABS_X / INPUT_ABS_Y and INPUT_BTN_TOUCH through the input subsystem.

compatible: "hynitron,cst9217"

include: [i2c-device.yaml, touchscreen-common.yaml]

properties:
  int-gpios:
    type: phandle-array
    required: true
    description: Interrupt line (pulses on touch).
  reset-gpios:
    type: phandle-array
    required: true
    description: Reset line, active low.
```
